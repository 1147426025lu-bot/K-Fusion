## crtos/jailhouse_overlay_pi4/nuttx/apps/benchmarks/bm2pid/Kconfig
```kconfig
config BENCHMARK_BM2PID
	bool "bm2pid: 3-axis cascaded PID control benchmark"
	default n
	---help---
		K-Fusion BM2 benchmark: a realistic periodic control workload.

		Three axes, each with a cascaded position/velocity PID, integral
		anti-windup and an 8-tap FIR on the feedback signal.  Runs at 1 kHz
		with clock_nanosleep(CLOCK_MONOTONIC, TIMER_ABSTIME), exactly like
		cyclictest, so the jitter numbers are directly comparable.

		Unlike cyclictest it also reports:
		  - per-cycle execution time and overrun count (exec > period)
		  - control quality (mean-square and max tracking error)

		The control-quality numbers are what reveals a fixed-point
		conversion that changed numeric behaviour: jitter may look fine
		while the controller has silently diverged.

		The hot loop never prints; output happens once at the end.
```

## crtos/jailhouse_overlay_pi4/nuttx/apps/benchmarks/fiveloop/Kconfig
```kconfig
config BENCHMARK_FIVELOOP
	bool "fiveloop: five-stage closed-loop fusion benchmark (ECoS PR5)"
	default n
	---help---
		K-Fusion closed-loop workload: sample -> fir -> pid -> clamp -> plant,
		with the feedback edge closing across period boundaries (z^-1).
		Runs the r/s/f probe contract at 1 kHz.  Modes:
		  fiveloop plan <cycles>   one release per period (fused)
		  fiveloop flat <cycles>   one release per stage (A/B control)
		  fiveloop shmwait         poll IVSHMEM for plan/flat commands
		Init uses ecos_boot_main so shmwait runs even without a serial
		console.  The FNV-1a digest must be identical for plan and flat.
```

## crtos/jailhouse_overlay_pi4/nuttx/apps/examples/xipc/Kconfig
```kconfig
config EXAMPLES_XIPC
	bool "xipc: ECoS cross-domain IPC ring (Jailhouse IVSHMEM)"
	default n
	---help---
		Minimal cross-domain publish/subscribe runtime between the root cell
		Linux and a NuttX inmate, carried over the Jailhouse IVSHMEM
		rw_section.

		Layout and ring operations live in ecos_xipc.h, shared byte-for-byte
		with the root side (kfusion/runtime/xshm/ecos_xipc.h). The deploy
		script copies it here; do not edit the copy.

		Requires the cell config to map the IVSHMEM rw_section
		(see crtos/jailhouse_overlay_pi4/configs/arm64/rpi4-nuttx.c).
```

## crtos/jailhouse_overlay_pi4/nuttx/apps/examples/xlat/Kconfig
```kconfig
config EXAMPLES_XLAT
	bool "xlat: cross-domain latency probe (Jailhouse IVSHMEM)"
	default n
	---help---
		Periodic timestamp probe running inside a NuttX Jailhouse inmate.

		It measures the in-cell wake-up jitter (t_wake - t_deadline) and
		publishes each sample's timestamps to the IVSHMEM rw_section so
		that the root cell Linux can measure the cross-domain delivery
		latency and its jitter.

		The app never prints to the console: the NuttX serial driver is
		interrupt driven and blocking, so any printf inside the measurement
		loop would perturb the measured object.

		Requires the cell config to declare the IVSHMEM regions
		(see crtos/jailhouse_overlay_pi4/configs/arm64/rpi4-nuttx.c).
```

## crtos/jailhouse_overlay_pi4/nuttx/apps/examples/xshm/Kconfig
```kconfig
config EXAMPLES_XSHM
	bool "xshm: cross-domain shared memory demo (Jailhouse IVSHMEM)"
	default n
	---help---
		NuttX (Jailhouse non-root cell) exchanges a minimal mailbox with the
		root cell Linux through the Jailhouse IVSHMEM rw_section.

		Requires the cell config to declare the IVSHMEM regions
		(see crtos/jailhouse_overlay_pi4/configs/arm64/rpi4-nuttx.c).
```
