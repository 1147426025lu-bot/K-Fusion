/*
 * Reserve 256 MiB @ 512 MiB for Jailhouse (matches rpi5.c / upstream rpi4 layout).
 * Compile: dtc -@ -I dts -O dtb -o jailhouse-mem.dtbo jailhouse-mem.dtso
 * Install: sudo cp jailhouse-mem.dtbo /boot/firmware/overlays/
 *          add to config.txt: dtoverlay=jailhouse-mem
 */
/dts-v1/;
/plugin/;

/ {
	fragment@0 {
		target-path = "/reserved-memory";
		__overlay__ {
			jailhouse@20000000 {
				reg = <0x0 0x20000000 0x0 0x10000000>;
				no-map;
			};
		};
	};
};
